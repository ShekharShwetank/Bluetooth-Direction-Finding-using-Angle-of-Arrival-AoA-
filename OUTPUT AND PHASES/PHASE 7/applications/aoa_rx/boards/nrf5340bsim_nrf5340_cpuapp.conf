## OUTPUT AND PHASES/PHASE 7/applications/aoa_rx/boards/nrf5340bsim_nrf5340_cpuapp.conf
```kconfig
# This file configures the network core (cpunet) build.

# Build the standard HCI IPC sample for the network core.
# This provides the Bluetooth controller that our main application will talk to.
# CONFIG_BT_HCI_IPC_NRF53=y

# Also enable MCUboot for the network core image, so it can be updated.
CONFIG_BOOTLOADER_MCUBOOT=y
```
